## patches/at91bootstrap/sama5d27_jupiter_nano_sd1_uboot_small_defconfig
```kconfig
CONFIG_SAMA5D2_LPDDR2SIP_VB=y
CONFIG_SAMA5D2_LPDDR2=y
CONFIG_RAM_128MB=y
CONFIG_SDCARD=y
CONFIG_SDHC1=y
CONFIG_JUMP_ADDR="0x23f00000"
CONFIG_DEBUG=y
# CONFIG_ENTER_NWD is not set
CONFIG_BACKUP_MODE=y
```
